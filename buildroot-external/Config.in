## buildroot-external/Config.in
```kconfig
source "$BR2_EXTERNAL_AMIPC_PATH/package/amipc-init/Config.in"
source "$BR2_EXTERNAL_AMIPC_PATH/package/attractmode/Config.in"
```

## buildroot-external/configs/amipc_x86_64_defconfig
```kconfig
# Architecture cible
BR2_x86_64=y
BR2_x86_corei7=y

# Systeme
BR2_TOOLCHAIN_BUILDROOT_CXX=y
BR2_SYSTEM_DHCP="eth0"
BR2_TARGET_GENERIC_HOSTNAME="amipc"
BR2_TARGET_GENERIC_ISSUE="AmiPC"
BR2_TARGET_GENERIC_ROOT_PASSWD=""
BR2_SYSTEM_BIN_SH_BUSYBOX=y
BR2_INIT_BUSYBOX=y
BR2_ROOTFS_DEVICE_CREATION_DYNAMIC_EUDEV=y

# Overlay et post-scripts
BR2_ROOTFS_OVERLAY="$(BR2_EXTERNAL_AMIPC_PATH)/board/amipc/overlay"
BR2_ROOTFS_POST_BUILD_SCRIPT="$(BR2_EXTERNAL_AMIPC_PATH)/board/amipc/post-build.sh"
BR2_ROOTFS_POST_IMAGE_SCRIPT="$(BR2_EXTERNAL_AMIPC_PATH)/board/amipc/post-image.sh"

# Noyau Linux minimal
BR2_LINUX_KERNEL=y
BR2_LINUX_KERNEL_LATEST_VERSION=y
BR2_LINUX_KERNEL_USE_ARCH_DEFAULT_CONFIG=y
BR2_LINUX_KERNEL_CONFIG_FRAGMENT_FILES="$(BR2_EXTERNAL_AMIPC_PATH)/board/amipc/linux-amipc.fragment"
BR2_LINUX_KERNEL_INSTALL_TARGET=y

# Bootloader
BR2_TARGET_GRUB2=y
BR2_TARGET_GRUB2_X86_64_EFI=y
BR2_TARGET_GRUB2_PC=y

# Bibliotheques graphiques et audio bas niveau
BR2_PACKAGE_LIBDRM=y
BR2_PACKAGE_MESA3D=y
BR2_PACKAGE_MESA3D_OPENGL_EGL=y
BR2_PACKAGE_MESA3D_OPENGL_GLX=y
BR2_PACKAGE_MESA3D_GBM=y
BR2_PACKAGE_MESA3D_GALLIUM_DRIVER_IRIS=y
BR2_PACKAGE_MESA3D_GALLIUM_DRIVER_RADEONSI=y
BR2_PACKAGE_MESA3D_GALLIUM_DRIVER_NOUVEAU=y
BR2_PACKAGE_MESA3D_GALLIUM_DRIVER_VIRGL=y
BR2_PACKAGE_MESA3D_GALLIUM_DRIVER_SWRAST=y
BR2_PACKAGE_ALSA_LIB=y
BR2_PACKAGE_ALSA_UTILS=y
BR2_PACKAGE_SDL2=y
BR2_PACKAGE_SDL2_SOUND=y

# Peripheriques d'entree
BR2_PACKAGE_LIBINPUT=y
BR2_PACKAGE_JOYUTILS=y

# Reseau (optionnel : scraping, mises a jour)
BR2_PACKAGE_OPENSSH=y
BR2_PACKAGE_CA_CERTIFICATES=y
BR2_PACKAGE_WPA_SUPPLICANT=y

# Gestion des supports amovibles
BR2_PACKAGE_UTIL_LINUX=y
BR2_PACKAGE_UTIL_LINUX_MOUNT=y
BR2_PACKAGE_EUDEV=y

# Emulation Amiga : RetroArch + core libretro-uae
BR2_PACKAGE_RETROARCH=y
BR2_PACKAGE_LIBRETRO_UAE=y

# Frontend AttractMode (paquet local, cf. package/attractmode)
BR2_PACKAGE_ATTRACTMODE=y
BR2_PACKAGE_SFML=y
BR2_PACKAGE_FONTCONFIG=y
BR2_PACKAGE_JPEG=y
BR2_PACKAGE_ZLIB=y
BR2_PACKAGE_EXPAT=y
BR2_PACKAGE_FREETYPE=y
BR2_PACKAGE_LIBVLC=y

# Superviseur de demarrage AmiPC (paquet local, cf. package/amipc-init)
BR2_PACKAGE_AMIPC_INIT=y

# Formats d'archives des jeux (zip, dms, ipf)
BR2_PACKAGE_UNZIP=y
BR2_PACKAGE_ZIP=y

# Systeme de fichiers image
BR2_TARGET_ROOTFS_EXT2=y
BR2_TARGET_ROOTFS_EXT2_4=y
BR2_TARGET_ROOTFS_ISO9660=y

# Taille de l'image
BR2_TARGET_ROOTFS_EXT2_SIZE="1500M"
```

## buildroot-external/package/amipc-init/Config.in
```kconfig
config BR2_PACKAGE_AMIPC_INIT
	bool "amipc-init"
	depends on BR2_PACKAGE_RETROARCH
	help
	  Scripts de demarrage et de supervision d'AmiPC :
	  lancement automatique du frontend AttractMode et
	  bascule vers l'emulateur PUAE (libretro-uae).
```

## buildroot-external/package/attractmode/Config.in
```kconfig
config BR2_PACKAGE_ATTRACTMODE
	bool "attractmode"
	depends on BR2_PACKAGE_SDL2
	depends on BR2_INSTALL_LIBSTDCPP
	depends on BR2_PACKAGE_HAS_UDEV
	select BR2_PACKAGE_SFML
	select BR2_PACKAGE_LIBVLC if BR2_PACKAGE_LIBVLC_AVAILABLE
	select BR2_PACKAGE_FONTCONFIG
	select BR2_PACKAGE_ZLIB
	select BR2_PACKAGE_JPEG
	select BR2_PACKAGE_EXPAT
	select BR2_PACKAGE_FREETYPE
	help
	  AttractMode est un frontend graphique multi-plateforme pour
	  systemes d'emulation, utilise par AmiPC comme interface de
	  selection des jeux Amiga.

	  https://github.com/mickelson/attract
```

## buildroot-external/package/sfml/Config.in
```kconfig
config BR2_PACKAGE_SFML
	bool "sfml"
	depends on BR2_INSTALL_LIBSTDCPP
	depends on BR2_PACKAGE_HAS_UDEV
	select BR2_PACKAGE_LIBDRM
	select BR2_PACKAGE_MESA3D
	select BR2_PACKAGE_MESA3D_OPENGL_EGL
	select BR2_PACKAGE_MESA3D_OPENGL_GLX if BR2_PACKAGE_XORG7
	select BR2_PACKAGE_FLAC
	select BR2_PACKAGE_LIBVORBIS
	select BR2_PACKAGE_OPENAL
	select BR2_PACKAGE_LIBXRANDR if BR2_PACKAGE_XORG7
	select BR2_PACKAGE_FREETYPE
	select BR2_PACKAGE_EUDEV
	help
	  Simple and Fast Multimedia Library : bibliotheque C++
	  multiplateforme utilisee par AttractMode (fenetrage, rendu
	  graphique, audio, entrees).

	  https://www.sfml-dev.org
```
